// SPDX-License-Identifier: GPL-2.0 OR MIT
/*
 * Copyright (C) 2025 Beckhoff Automation GmbH & Co. KG
 */

/dts-v1/;


#include "mt8188.dtsi"
#include "mt8188-beckhoff-cb3014.dtsi"


/ {
	model = "Beckhoff CB3014 MT8390";
	compatible = "beckhoff,mt8390-sm0101-cb3014",
		     "beckhoff,sm0101",
		     "mediatek,mt8390",
		     "mediatek,mt8188";

};
